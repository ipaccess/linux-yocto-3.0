## drivers/clocksource/Kconfig
```kconfig
config CLKSRC_I8253
	bool

config CLKSRC_MMIO
	bool

config DW_APB_TIMER_PLATFORM
	bool
	depends on HAVE_CLK
	select DW_APB_TIMER

config DW_APB_TIMER
	bool
```

## drivers/ipa/Kconfig
```kconfig
################################################################################
# 
# Copyright (c) 2009 ip.access Ltd.
#
#  This program is free software; you can redistribute  it and/or modify it
#  under  the terms of  the GNU General  Public License as published by the
#  Free Software Foundation;  either version 2 of the  License, or (at your
#  option) any later version.
#
# 
##############################################################################
# Filename: 
##############################################################################

#
# IPAccess device drivers
#

menu "IP Access Drivers"

config IPACCESS
    tristate

config IPACCESS_CPETD
    tristate "cpetd support"
    select IPACCESS
    ---help---
      The CPE Timer Device Driver. This device driver is used to give
      fine grained timer ticks to user mode applications e.g. 3g ctrl
      and data apps.
      
config IPACCESS_LED
    tristate "leddriver support"
    select IPACCESS
    ---help---
      Support for the 3GAP ip202ff xbplus & xd leds.

config IPACCESS_2G
    tristate "2G test over I2C"
    depends on EXPERIMENTAL
    help
      If you say yes here you get support for 2G test.

      This driver can also be built as a module.  If so, the module
      will be called ipa2g.


endmenu
```

## drivers/picochip/Kconfig
```kconfig
# $picoChipHeaderSubst$
#
# picoChip device drivers
#

menu "picoChip Drivers"

config PICOCHIP
    tristate

config PICOIF
    tristate "picoIf driver"
    ---help---
      This driver provides a kernelspace API for accessing picoArray devices
      and a userspace interface through /dev/picoif

config PICOIF_DMAPOOL
    bool "Picoif DMA buffer pooling"
    depends on PICOIF
    ---help---
      This option enables pooling and reuse of a number of DMA coherent memory
      buffers by the transport channels.

config PICOIF_PC3XX
    bool "PC3XX picoIf support"
    depends on PICOIF && ARCH_PICOXCELL  && DW_DMAC
    ---help---
      Selecting yes here enables PC3XX support in picoIf.

config PICOIF_DEFAULT_DEBUG_LEVEL
    int "Default debugging level for the picoIf driver (0 = quiet, 9 = noisy)"
    default "1"
    help
      This sets the default debug verbosity of the driver at load time. The
      values for each component may then be ajusted with the *lvl entries in
      /debug/picoif/.

config PICOIF_DEBUG_TO_CONSOLE
    bool "Print picoIf debug messages to the console"
    default false
    help
      Enabling this causes picoIf debug messages to be printed to the console
      in addition to the debug log in /debug/picoconnect/log. This is mainly
      useful when working on the drivers themselves.

endmenu
```
